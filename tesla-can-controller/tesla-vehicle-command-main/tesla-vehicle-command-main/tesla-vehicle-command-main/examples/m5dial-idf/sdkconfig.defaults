## tesla-can-controller/tesla-vehicle-command-main/tesla-vehicle-command-main/tesla-vehicle-command-main/examples/m5dial-idf/sdkconfig.defaults
```kconfig
# Target
CONFIG_IDF_TARGET="esp32s3"

# Bluetooth NimBLE
CONFIG_BT_ENABLED=y
CONFIG_BT_NIMBLE_ENABLED=y
CONFIG_BT_NIMBLE_MAX_CONNECTIONS=3
CONFIG_BT_NIMBLE_ROLE_CENTRAL=y
CONFIG_BT_NIMBLE_SVC_GAP_DEVICE_NAME="M5Dial-TeslaBLE"

# LVGL & Display buffers
CONFIG_LV_CONF_SKIP=y
CONFIG_LVGL_TICK_CUSTOM=y
CONFIG_LVGL_MEM_SIZE_KILOBYTES=128
CONFIG_LV_COLOR_DEPTH_16=y
CONFIG_LV_COLOR_SCREEN_TRANSP=y

# SPI DMA
CONFIG_SPI_MASTER_ISR_IN_IRAM=y

# PSRAM (if M5Dial version supports)
CONFIG_SPIRAM_SUPPORT=y
CONFIG_ESP32S3_SPIRAM_SUPPORT=y

# NVS
CONFIG_PARTITION_TABLE_CUSTOM=y
CONFIG_PARTITION_TABLE_FILENAME="partitions.csv"
CONFIG_NVS_ENCRYPTION=y
CONFIG_NVS_SEC_KEY_PROTECT_USING_FLASH_ENC=n
CONFIG_NVS_SEC_KEY_PROTECT_USING_HMAC=y
CONFIG_NVS_SEC_HMAC_EFUSE_KEY_ID=4
```
